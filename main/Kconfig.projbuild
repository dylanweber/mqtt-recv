## main/Kconfig.projbuild
```kconfig
# put here your custom config value
menu "Example Configuration"
# config ESP_WIFI_SSID
#     string "WiFi SSID"
#     default "myssid"
#     help
#     SSID (network name) for the example to connect to.

# config ESP_WIFI_PASSWORD
#     string "WiFi Password"
#     default "mypassword"
#     help
#     WiFi password (WPA or WPA2) for the example to use.

config ESP_MAXIMUM_RETRY
	int "Retry attempts"
	default 3
	help
	How many tries are attempted when connecting to the network.

config DHCP_NAME
	string "Hostname"
	default "esp32"
	help
	Name sent to the router defining the hostname.

config DELETE_ON_FAIL
	bool "Delete Wi-Fi configuration once it fails?"

endmenu
```
